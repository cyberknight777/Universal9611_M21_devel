## fs/crypto/Kconfig
```kconfig
config FS_ENCRYPTION
	bool "FS Encryption (Per-file encryption)"
	select CRYPTO
	select CRYPTO_HASH
	select CRYPTO_BLKCIPHER
	select KEYS
	help
	  Enable encryption of files and directories.  This
	  feature is similar to ecryptfs, but it is more memory
	  efficient since it avoids caching the encrypted and
	  decrypted pages in the page cache.  Currently Ext4,

config FS_INLINE_ENCRYPTION
	bool "Enable inline encryption"
	depends on FS_ENCRYPTION
	depends on BLK_DEV_CRYPT
	default y
	help
	  This option enables inline encryption to support inline crypto H/W.
```
